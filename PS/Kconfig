## PS/Kconfig
```kconfig
menu "wiota PS"

config UC8288_MODULE
    bool "use at cmd, default open(UC8288_MODULE)"
    default y
    select RT_USING_AT
    select AT_USING_SERVER

config _QUICK_CONNECT_
    bool "open quick connect, default open(_QUICK_CONNECT_)"
    default y

config _FPGA_
    bool "default open(_FPGA_)"
    default y

config _RT_THREAD_
    bool "RT_Thread default open(_RT_THREAD_)"
    default y

config _ALLOW_TRACE_PRITF_TEST_
    bool "default open(_ALLOW_TRACE_PRITF_TEST_)"
    default y

config UC8288_FACTORY
    bool "at factory mode,recv and send test, default close(UC8288_FACTORY)"
    default n

config _L1_FACTORY_FUNC_
    bool "l1 factory mode, default open(_L1_FACTORY_FUNC_)"
    default y

config _CLK_GATING_
    bool "clk gating, default open(_CLK_GATING_)"
    default y

config _LPM_PAGING_
    bool "lpm paging mode, default open(_LPM_PAGING_)"
    default y

config _NARROW_BAND_
    bool "narrow band mode, default open(_NARROW_BAND_)"
    default y

config _SUBFRAME_MODE_
    bool "subframe mode(include two way mode), default open(_SUBFRAME_MODE_)"
    default y

config _OLD_UNI_MODE_
    bool "old unicast mode, default open(_OLD_UNI_MODE_)"
    default y

config _NEW_UNI_MODE_
    bool "new unicast mode, default open(_NEW_UNI_MODE_)"
    default y

config _BROADCAST_MODE_
    bool "broadcast mode, default open(_BROADCAST_MODE_)"
    default y

config _NARROW_BAND_FUNC_
    bool "super narrow mode, default open(_NARROW_BAND_FUNC_)"
    default y

endmenu
```
